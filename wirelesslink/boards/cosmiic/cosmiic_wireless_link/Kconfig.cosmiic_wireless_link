## wirelesslink/boards/cosmiic/cosmiic_wireless_link/Kconfig.cosmiic_wireless_link
```kconfig
# Copyright (c) 2024 Nordic Semiconductor
# SPDX-License-Identifier: Apache-2.0

config BOARD_COSMIIC_WIRELESS_LINK
	select SOC_NRF5340_CPUNET_QKAA if BOARD_COSMIIC_WIRELESS_LINK_NRF5340_CPUNET
	select SOC_NRF5340_CPUAPP_QKAA if BOARD_COSMIIC_WIRELESS_LINK_NRF5340_CPUAPP || \
					  BOARD_COSMIIC_WIRELESS_LINK_NRF5340_CPUAPP_NS || \
					  BOARD_COSMIIC_WIRELESS_LINK_NRF5340_CPUAPP_NRF7001 || \
					  BOARD_COSMIIC_WIRELESS_LINK_NRF5340_CPUAPP_NRF7001_NS
```

## wirelesslink/boards/cosmiic/cosmiic_wireless_link/board.yml
```yaml
board:
  name: cosmiic_wireless_link
  full_name: COSMIIC Wireless Link
  vendor: nordic
  socs:
    - name: nrf5340
      variants:
        - name: ns
          cpucluster: cpuapp
```

## wirelesslink/boards/cosmiic/cosmiic_wireless_link/cosmiic_wireless_link_nrf5340_cpuapp_defconfig
```kconfig
# SPDX-License-Identifier: Apache-2.0

# Enable MPU
CONFIG_ARM_MPU=y

# Enable TrustZone-M
CONFIG_ARM_TRUSTZONE_M=y

# Enable GPIO
CONFIG_GPIO=y

# Enable UART driver
CONFIG_SERIAL=y

# Enable UART via CDC_ACM
CONFIG_UART_ASYNC_API=y
CONFIG_UART_INTERRUPT_DRIVEN=y
CONFIG_UART_ASYNC_ADAPTER=y
CONFIG_USB_DEVICE_STACK=y
CONFIG_USB_DEVICE_REMOTE_WAKEUP=n
CONFIG_USB_CDC_ACM=y


# Enable console
CONFIG_CONSOLE=y
CONFIG_UART_CONSOLE=y

# Enable RNG
CONFIG_MBEDTLS_PSA_CRYPTO_EXTERNAL_RNG=y
CONFIG_MBEDTLS_PSA_CRYPTO_EXTERNAL_RNG_ALLOW_NON_CSPRNG=y

# ISN needs CS-Rand which isn't supported upstream for nRF boards
CONFIG_NET_TCP_ISN_RFC6528=n
```
